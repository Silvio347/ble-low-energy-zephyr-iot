## CMakeLists.txt
```
cmake_minimum_required(VERSION 3.20.0)
find_package(Zephyr REQUIRED HINTS $ENV{ZEPHYR_BASE})

project(lowble)
set(PROJECT_VER "0.1.0")
target_sources(app PRIVATE
  src/main.c
  src/dht11.c
  src/payload_codec.c
  src/ble_adv.c
  src/power_profile.c
  src/battery_sim.c
)

zephyr_include_directories(include)
```

## Kconfig
```
mainmenu "LowBLE nRF54L15 sensor"

source "Kconfig.zephyr"

menu "LowBLE sensor application"

choice LOWB_POWER_PROFILE
	prompt "Operation profile"
	default LOWB_PROFILE_ECO

config LOWB_PROFILE_DEMO
	bool "Demo"
	help
	  Two-second transmit interval, verbose application behavior, and
	  sensor power kept on after startup.

config LOWB_PROFILE_BALANCED
	bool "Balanced"
	help
	  Ten-second transmit interval with moderate behavior for functional
	  testing.

config LOWB_PROFILE_ECO
	bool "Eco"
	help
	  Sixty-second transmit interval, short advertising window, and DHT11
	  power cycled around each reading.

endchoice

config LOWB_DEVICE_ID
	int "Sensor node device ID"
	default 347
	range 0 65535

config LOWB_COMPANY_ID
	hex "BLE manufacturer company ID"
	default 0xffff
	range 0x0000 0xffff
	help
	  Prototype-only company ID used in BLE manufacturer data. Replace this
	  before product use with an assigned Bluetooth SIG company identifier.

config LOWB_BATTERY_INITIAL_MV
	int "Initial simulated battery voltage in mV"
	default 3000
	range 0 65535

config LOWB_BATTERY_MIN_MV
	int "Minimum simulated battery voltage in mV"
	default 2400
	range 0 65535

config LOWB_BATTERY_DROP_EVERY_N_PACKETS
	int "Simulated battery drop cadence"
	default 16
	range 1 65535
	help
	  The simulated battery decreases by 1 mV every N packets until the
	  minimum voltage is reached.

endmenu
```

## prj.conf
```kconfig
CONFIG_GPIO=y

CONFIG_BT=y
CONFIG_BT_BROADCASTER=y
CONFIG_BT_DEVICE_NAME="lowble-nrf54"

CONFIG_LOG=y
CONFIG_LOG_MODE_DEFERRED=y
CONFIG_LOG_DEFAULT_LEVEL=3

CONFIG_PM=y

CONFIG_MAIN_STACK_SIZE=2048
CONFIG_SYSTEM_WORKQUEUE_STACK_SIZE=2048

CONFIG_LOWB_PROFILE_DEMO=y
CONFIG_LOWB_DEVICE_ID=347
CONFIG_LOWB_COMPANY_ID=0xffff
```

## boards/nrf54l15dk_nrf54l15_cpuapp.overlay
```dts
/ {
	dht11_sensor: dht11-sensor {
		compatible = "lowble,dht11-gpio";
		power-gpios = <&gpio1 10 GPIO_ACTIVE_HIGH>;
		data-gpios = <&gpio1 11 (GPIO_PULL_UP | GPIO_ACTIVE_HIGH)>;
	};
};
```

## dts/bindings/sensor/lowble,dht11-gpio.yaml
```yaml
description: GPIO based DHT11 sensor

compatible: "lowble,dht11-gpio"

properties:
  power-gpios:
    type: phandle-array
    required: true

  data-gpios:
    type: phandle-array
    required: true
```

## src/main.c
```c
#include <errno.h>
#include <stdint.h>

#include <zephyr/kernel.h>
#include <zephyr/logging/log.h>
#include <zephyr/sys/util.h>

#include "battery_sim.h"
#include "ble_adv.h"
#include "dht11.h"
#include "payload_codec.h"
#include "power_profile.h"

LOG_MODULE_REGISTER(main, CONFIG_LOG_DEFAULT_LEVEL);

static const struct power_profile *profile;
static struct k_work_delayable cycle_work;
static struct k_work_delayable adv_stop_work;
static uint32_t packet_counter;

static void schedule_next_cycle(void)
{
	k_work_schedule(&cycle_work, K_MSEC(profile->send_interval_ms));
}

static void adv_stop_handler(struct k_work *work)
{
	ARG_UNUSED(work);

	int err = ble_adv_stop();

	if (err == 0) {
		packet_counter++;
	}
}

static int read_sensor_for_profile(struct dht11_sample *sample)
{
	int err;

	if (profile->power_cycle_sensor) {
		err = dht11_power_on();
		if (err) {
			return err;
		}

		k_msleep(profile->dht11_warmup_ms);
	}

	err = dht11_read(sample);

	if (profile->power_cycle_sensor) {
		int power_err = dht11_power_off();

		if (power_err && err == 0) {
			err = power_err;
		}
	}

	return err;
}

static void cycle_handler(struct k_work *work)
{
	struct dht11_sample dht_sample;
	struct payload_measurement measurement = { 0 };
	sensor_payload_t payload;
	uint8_t flags = FLAG_BATTERY_SIM;
	uint16_t battery_mv;
	int err;

	ARG_UNUSED(work);

	err = read_sensor_for_profile(&dht_sample);
	if (err == 0) {
		flags |= FLAG_SENSOR_OK;
		measurement.temperature_x10 = dht_sample.temperature_x10;
		measurement.humidity_x10 = dht_sample.humidity_x10;
	} else {
		flags |= FLAG_DHT_ERROR;
		LOG_WRN("DHT11 read failed: %d", err);
	}

	if (profile->low_power_mode) {
		flags |= FLAG_LOW_POWER_MODE;
	}

	battery_mv = battery_sim_next_mv();

	payload_codec_build(&payload, &measurement, battery_mv, packet_counter, flags);

	if (profile->verbose_logs) {
		LOG_INF("payload counter=%u temp_x10=%d hum_x10=%u batt=%u flags=0x%02x checksum=0x%02x",
			packet_counter,
			measurement.temperature_x10,
			measurement.humidity_x10,
			battery_mv,
			flags,
			payload.checksum);
	}

	err = ble_adv_start(&payload);
	if (err) {
		LOG_ERR("Could not start advertising: %d", err);
		schedule_next_cycle();
		return;
	}

	k_work_schedule(&adv_stop_work, K_MSEC(profile->adv_window_ms));
	schedule_next_cycle();
}

int main(void)
{
	int err;

	profile = power_profile_get();

	LOG_INF("LowBLE nRF54L15 sensor starting, profile=%s", profile->name);

	err = dht11_init();
	if (err) {
		LOG_ERR("DHT11 init failed: %d", err);
		return err;
	}

	if (!profile->power_cycle_sensor) {
		err = dht11_power_on();
		if (err) {
			LOG_ERR("DHT11 power on failed: %d", err);
			return err;
		}

		k_msleep(profile->dht11_warmup_ms);
	}

	battery_sim_init();

	err = ble_adv_init();
	if (err) {
		return err;
	}

	k_work_init_delayable(&cycle_work, cycle_handler);
	k_work_init_delayable(&adv_stop_work, adv_stop_handler);
	k_work_schedule(&cycle_work, K_NO_WAIT);

	while (true) {
		k_sleep(K_FOREVER);
	}

	return 0;
}
```

## include/battery_sim.h
```c
#pragma once

#include <stdint.h>

void battery_sim_init(void);
uint16_t battery_sim_next_mv(void);
```

## include/ble_adv.h
```c
#pragma once

#include "payload_codec.h"

int ble_adv_init(void);
int ble_adv_start(const sensor_payload_t *payload);
int ble_adv_stop(void);
```

## include/dht11.h
```c
#pragma once

#include <stdint.h>

struct dht11_sample {
	int16_t temperature_x10;
	uint16_t humidity_x10;
};

int dht11_init(void);
int dht11_power_on(void);
int dht11_power_off(void);
int dht11_read(struct dht11_sample *sample);
```

## include/payload_codec.h
```c
#pragma once

#include <stdbool.h>
#include <stddef.h>
#include <stdint.h>

#include <zephyr/sys/util.h>

#define FLAG_SENSOR_OK        BIT(0)
#define FLAG_BATTERY_SIM      BIT(1)
#define FLAG_LOW_POWER_MODE   BIT(2)
#define FLAG_DHT_ERROR        BIT(3)

typedef struct __attribute__((packed)) {
	uint16_t device_id;
	int16_t temperature_x10;
	uint16_t humidity_x10;
	uint16_t battery_mv;
	uint32_t counter;
	uint8_t flags;
	uint8_t checksum;
} sensor_payload_t;

struct payload_measurement {
	int16_t temperature_x10;
	uint16_t humidity_x10;
};

void payload_codec_build(sensor_payload_t *payload,
			 const struct payload_measurement *measurement,
			 uint16_t battery_mv,
			 uint32_t counter,
			 uint8_t flags);

uint8_t payload_codec_checksum(const sensor_payload_t *payload);
bool payload_codec_is_valid(const sensor_payload_t *payload);
const uint8_t *payload_codec_bytes(const sensor_payload_t *payload);
size_t payload_codec_size(void);
```

## include/power_profile.h
```c
#pragma once

#include <stdbool.h>
#include <stdint.h>

enum power_profile_id {
	POWER_PROFILE_DEMO,
	POWER_PROFILE_BALANCED,
	POWER_PROFILE_ECO,
};

struct power_profile {
	enum power_profile_id id;
	const char *name;
	uint32_t send_interval_ms;
	uint32_t adv_window_ms;
	uint32_t dht11_warmup_ms;
	bool verbose_logs;
	bool power_cycle_sensor;
	bool low_power_mode;
};

const struct power_profile *power_profile_get(void);
```

## src/battery_sim.c
```c
#include "battery_sim.h"

#include <zephyr/kernel.h>

static uint16_t battery_mv;
static uint32_t packet_count;

void battery_sim_init(void)
{
	battery_mv = CONFIG_LOWB_BATTERY_INITIAL_MV;
	packet_count = 0;
}

uint16_t battery_sim_next_mv(void)
{
	packet_count++;

	if ((packet_count % CONFIG_LOWB_BATTERY_DROP_EVERY_N_PACKETS) == 0U &&
	    battery_mv > CONFIG_LOWB_BATTERY_MIN_MV) {
		battery_mv--;
	}

	return battery_mv;
}
```

## src/ble_adv.c
```c
#include "ble_adv.h"

#include <errno.h>
#include <stddef.h>
#include <string.h>

#include <zephyr/bluetooth/bluetooth.h>
#include <zephyr/bluetooth/hci.h>
#include <zephyr/logging/log.h>
#include <zephyr/sys/byteorder.h>
#include <zephyr/sys/util.h>

LOG_MODULE_REGISTER(ble_adv, CONFIG_LOG_DEFAULT_LEVEL);

#define MFG_DATA_SIZE (sizeof(uint16_t) + sizeof(sensor_payload_t))

static uint8_t mfg_data[MFG_DATA_SIZE];
static bool advertising;

int ble_adv_init(void)
{
	int err = bt_enable(NULL);

	if (err) {
		LOG_ERR("Bluetooth init failed: %d", err);
		return err;
	}

	LOG_INF("Bluetooth initialized");
	return 0;
}

int ble_adv_start(const sensor_payload_t *payload)
{
	struct bt_data ad[] = {
		BT_DATA(BT_DATA_MANUFACTURER_DATA, mfg_data, sizeof(mfg_data)),
	};
	int err;

	if (payload == NULL) {
		return -EINVAL;
	}

	if (advertising) {
		err = ble_adv_stop();
		if (err) {
			return err;
		}
	}

	sys_put_le16(CONFIG_LOWB_COMPANY_ID, mfg_data);
	memcpy(&mfg_data[sizeof(uint16_t)], payload_codec_bytes(payload), payload_codec_size());

	err = bt_le_adv_start(BT_LE_ADV_NCONN, ad, ARRAY_SIZE(ad), NULL, 0);
	if (err) {
		LOG_ERR("BLE advertising start failed: %d", err);
		return err;
	}

	advertising = true;
	return 0;
}

int ble_adv_stop(void)
{
	int err;

	if (!advertising) {
		return 0;
	}

	err = bt_le_adv_stop();
	if (err) {
		LOG_ERR("BLE advertising stop failed: %d", err);
		return err;
	}

	advertising = false;
	return 0;
}
```

## src/dht11.c
```c
#include "dht11.h"

#include <errno.h>
#include <stddef.h>
#include <stdint.h>

#include <zephyr/device.h>
#include <zephyr/devicetree.h>
#include <zephyr/drivers/gpio.h>
#include <zephyr/kernel.h>
#include <zephyr/logging/log.h>
#include <zephyr/sys/util.h>

LOG_MODULE_REGISTER(dht11, CONFIG_LOG_DEFAULT_LEVEL);

#define DHT11_NODE DT_NODELABEL(dht11_sensor)

BUILD_ASSERT(DT_NODE_EXISTS(DHT11_NODE), "Missing dht11_sensor devicetree node");

static const struct gpio_dt_spec power_gpio =
	GPIO_DT_SPEC_GET(DHT11_NODE, power_gpios);
static const struct gpio_dt_spec data_gpio =
	GPIO_DT_SPEC_GET(DHT11_NODE, data_gpios);

static int wait_for_level(int expected_level, uint32_t timeout_us)
{
	uint32_t start_cycles = k_cycle_get_32();
	uint32_t timeout_cycles = k_us_to_cyc_ceil32(timeout_us);

	while ((uint32_t)(k_cycle_get_32() - start_cycles) <= timeout_cycles) {
		int value = gpio_pin_get_dt(&data_gpio);

		if (value < 0) {
			return value;
		}

		if (value == expected_level) {
			return 0;
		}

		k_busy_wait(2);
	}

	return -ETIMEDOUT;
}

static int read_bit(uint8_t *bit)
{
	int err;

	err = wait_for_level(1, 80);
	if (err) {
		return err;
	}

	k_busy_wait(40);

	err = gpio_pin_get_dt(&data_gpio);
	if (err < 0) {
		return err;
	}

	*bit = err ? 1U : 0U;

	err = wait_for_level(0, 90);
	if (err) {
		return err;
	}

	return 0;
}

int dht11_init(void)
{
	int err;

	if (!gpio_is_ready_dt(&power_gpio)) {
		LOG_ERR("DHT11 power GPIO controller is not ready");
		return -ENODEV;
	}

	if (!gpio_is_ready_dt(&data_gpio)) {
		LOG_ERR("DHT11 data GPIO controller is not ready");
		return -ENODEV;
	}

	err = gpio_pin_configure_dt(&power_gpio, GPIO_OUTPUT_INACTIVE);
	if (err) {
		return err;
	}

	err = gpio_pin_configure_dt(&data_gpio, GPIO_INPUT);
	if (err) {
		return err;
	}

	return 0;
}

int dht11_power_on(void)
{
	return gpio_pin_set_dt(&power_gpio, 1);
}

int dht11_power_off(void)
{
	return gpio_pin_set_dt(&power_gpio, 0);
}

int dht11_read(struct dht11_sample *sample)
{
	uint8_t raw[5] = { 0 };
	int err;

	if (sample == NULL) {
		return -EINVAL;
	}

	err = gpio_pin_configure_dt(&data_gpio, GPIO_OUTPUT_ACTIVE);
	if (err) {
		return err;
	}

	gpio_pin_set_dt(&data_gpio, 0);
	k_msleep(20);
	gpio_pin_set_dt(&data_gpio, 1);
	k_busy_wait(30);

	err = gpio_pin_configure_dt(&data_gpio, GPIO_INPUT);
	if (err) {
		return err;
	}

	err = wait_for_level(0, 100);
	if (err) {
		return err;
	}

	err = wait_for_level(1, 100);
	if (err) {
		return err;
	}

	err = wait_for_level(0, 100);
	if (err) {
		return err;
	}

	for (size_t byte = 0; byte < ARRAY_SIZE(raw); byte++) {
		for (size_t bit_index = 0; bit_index < 8; bit_index++) {
			uint8_t bit;

			err = read_bit(&bit);
			if (err) {
				return err;
			}

			raw[byte] = (raw[byte] << 1) | bit;
		}
	}

	if (((raw[0] + raw[1] + raw[2] + raw[3]) & 0xff) != raw[4]) {
		return -EBADMSG;
	}

	sample->humidity_x10 = (uint16_t)raw[0] * 10U + raw[1];
	sample->temperature_x10 = (int16_t)raw[2] * 10 + raw[3];

	return 0;
}
```

## src/payload_codec.c
```c
#include "payload_codec.h"

#include <stddef.h>
#include <string.h>

#include <zephyr/sys/byteorder.h>

BUILD_ASSERT(sizeof(sensor_payload_t) == 14, "sensor_payload_t must be 14 bytes");

uint8_t payload_codec_checksum(const sensor_payload_t *payload)
{
	const uint8_t *bytes = (const uint8_t *)payload;
	uint8_t sum = 0U;

	for (size_t i = 0; i < offsetof(sensor_payload_t, checksum); i++) {
		sum += bytes[i];
	}

	return sum;
}

bool payload_codec_is_valid(const sensor_payload_t *payload)
{
	if (payload == NULL) {
		return false;
	}

	return payload->checksum == payload_codec_checksum(payload);
}

void payload_codec_build(sensor_payload_t *payload,
			 const struct payload_measurement *measurement,
			 uint16_t battery_mv,
			 uint32_t counter,
			 uint8_t flags)
{
	memset(payload, 0, sizeof(*payload));

	payload->device_id = sys_cpu_to_le16(CONFIG_LOWB_DEVICE_ID);

	if (measurement != NULL) {
		payload->temperature_x10 = sys_cpu_to_le16((uint16_t)measurement->temperature_x10);
		payload->humidity_x10 = sys_cpu_to_le16(measurement->humidity_x10);
	}

	payload->battery_mv = sys_cpu_to_le16(battery_mv);
	payload->counter = sys_cpu_to_le32(counter);
	payload->flags = flags;
	payload->checksum = payload_codec_checksum(payload);
}

const uint8_t *payload_codec_bytes(const sensor_payload_t *payload)
{
	return (const uint8_t *)payload;
}

size_t payload_codec_size(void)
{
	return sizeof(sensor_payload_t);
}
```

## src/power_profile.c
```c
#include "power_profile.h"

#include <zephyr/sys/util_macro.h>

static const struct power_profile demo_profile = {
	.id = POWER_PROFILE_DEMO,
	.name = "demo",
	.send_interval_ms = 2000,
	.adv_window_ms = 1200,
	.dht11_warmup_ms = 1000,
	.verbose_logs = true,
	.power_cycle_sensor = false,
	.low_power_mode = false,
};

static const struct power_profile balanced_profile = {
	.id = POWER_PROFILE_BALANCED,
	.name = "balanced",
	.send_interval_ms = 10000,
	.adv_window_ms = 800,
	.dht11_warmup_ms = 1000,
	.verbose_logs = true,
	.power_cycle_sensor = true,
	.low_power_mode = false,
};

static const struct power_profile eco_profile = {
	.id = POWER_PROFILE_ECO,
	.name = "eco",
	.send_interval_ms = 60000,
	.adv_window_ms = 350,
	.dht11_warmup_ms = 1000,
	.verbose_logs = false,
	.power_cycle_sensor = true,
	.low_power_mode = true,
};

const struct power_profile *power_profile_get(void)
{
	if (IS_ENABLED(CONFIG_LOWB_PROFILE_DEMO)) {
		return &demo_profile;
	}

	if (IS_ENABLED(CONFIG_LOWB_PROFILE_BALANCED)) {
		return &balanced_profile;
	}

	return &eco_profile;
}
```
